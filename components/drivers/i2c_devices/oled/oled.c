/**
 * @brief 文件描述：待更新
 * @author 小鱼 (fishros@foxmail.com)
 * @version V1.0.0
 * @date 2022-07-07
 * @copyright 版权所有：FishBot Open Source Organization
 */
#include "oled.h"

#define FISHBOT_MODLUE "OLED"
#define OLED_MAX_LINES 10
#define OLED_START_LINE 1

static uint8_t last_line_ = 2;
/*
  (0) !(1) "(2) #(3) $(4) %(5) &(6) '(7) ((8) )(9) *(10) +(11) ,(12) -(13) .(14)
 /(15) 0(16) 1(17) 2(18) 3(19) 4(20) 5(21) 6(22) 7(23) 8(24) 9(25) :(26) ;(27)
 <(28) =(29) >(30) ?(31)
 @(32) A(33) B(34) C(35) D(36) E(37) F(38) G(39) H(40) I(41) J(42) K(43) L(44)
 M(45) N(46) O(47) P(48) Q(49) R(50) S(51) T(52) U(53) V(54) W(55) X(56) Y(57)
 Z(58) [(59) \(60) ](61) ^(62) _(63)
 `(64) a(65) b(66) c(67) d(68) e(69) f(70) g(71) h(72) i(73) j(74) k(75) l(76)
 m(77) n(78) o(79) p(80) q(81) r(82) s(83) t(84) u(85) v(86) w(87) x(88) y(89)
 z(90) {(91) |(92) }(93) ~(94)
 */
uint8_t ascii[95][6] = {
    {0x00, 0x00, 0x00, 0x00, 0x00, 0x00},  // sp
    {0x00, 0x00, 0x00, 0x2f, 0x00, 0x00},  // !
    {0x00, 0x00, 0x07, 0x00, 0x07, 0x00},  // "
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    {0x14, 0x14, 0x14, 0x14, 0x14, 0x14},  // horiz lines
};

void oled_clear(void) {
  for (int x = 0; x < 8; x++) {
    esp32_i2c_write_byte(OLED_ADDR, 0x00, 0xb0 + x);
    esp32_i2c_write_byte(OLED_ADDR, 0x00, 0x00);
    esp32_i2c_write_byte(OLED_ADDR, 0x00, 0x10);
    for (int y = 0; y < 128; y++) esp32_i2c_write_byte(OLED_ADDR, 0x40, 0x00);
  }
}

void oled_setxy(uint8_t x, uint8_t y) {
  esp32_i2c_write_byte(OLED_ADDR, 0x00, 0xb0 + y);
  esp32_i2c_write_byte(OLED_ADDR, 0x00, (x & 0x0f));
  esp32_i2c_write_byte(OLED_ADDR, 0x00, ((x & 0xf0) >> 4) | 0x10);
}

//初始化oled
bool oled_init() {
  uint8_t cmd_data[] = {0xae, 0x20, 0x10, 0xb0, 0xc8, 0x00, 0x10,
                        0x40, 0x81, 0x7f, 0xa1, 0xa6, 0xa8, 0x3f,
                        0xa4, 0xd3, 0x00, 0xd5, 0xf0, 0xd9, 0x22,
                        0xda, 0x12, 0xdb, 0x20, 0x8d, 0x14, 0xaf};
  esp32_i2c_write_bytes(OLED_ADDR, 0x00, 28, cmd_data);
  oled_clear();
  oled_ascii8(0, 0, "        FISHBOT     ");
  oled_ascii8(0, 1, "Ver :V1.0.0.220820  ");
  // oled_show_ascii_auto_line("2022-07-07");
  ESP_LOGI(FISHBOT_MODLUE, "init success!");
  return true;
}

bool oled_show_ascii_auto_line(char *str) {
  if (strlen(str) > 21) {
    ESP_LOGW(FISHBOT_MODLUE, "len can't >21 char!");
    return false;
  }
  oled_ascii8(0, last_line_, "                       ");
  oled_ascii8(0, last_line_, str);
  last_line_++;
  if (last_line_ > OLED_MAX_LINES) {
    last_line_ = OLED_START_LINE;
  }
  return true;
}

void oled_ascii(uint8_t x, uint8_t y, char *str) {
  oled_setxy(x, y);
  for (int i = 0; i < 16 && (str[i] != 0); i++) {
    for (int j = 0; j < 8; j++) {
      esp32_i2c_write_byte(OLED_ADDR, 0x40, ascii[str[i] - 32][j]);
    }
  }
  oled_setxy(x, y + 1);
  for (int i = 0; i < 16 && (str[i] != 0); i++) {
    for (int j = 8; j < 16; j++) {
      esp32_i2c_write_byte(OLED_ADDR, 0x40, ascii[str[i] - 32][j]);
    }
  }
}

void oled_ascii8(uint8_t x, uint8_t y, char *str) {
  oled_setxy(x, y);
  for (int i = 0; i < 21 && (str[i] != 0); i++) {
    for (int j = 0; j < 6; j++) {
      esp32_i2c_write_byte(OLED_ADDR, 0x40, ascii[str[i] - 32][j]);
    }
  }
}
